## firmware/src/components/tmc2209_bind/Kconfig.projbuild
```kconfig
menu "STEF Board"

    comment "Single-wire UART to every TMC2209"

    config STEF_TMC_UART_NUM
        int "UART peripheral"
        range 1 2
        default 1
        help
            Not 0: that one carries the console.

    config STEF_TMC_UART_TX_GPIO
        int "UART TX GPIO"
        range 0 48
        default 42
        help
            Goes to PDN_UART through the series resistor. TX and RX are tied
            together at the driver, so the ESP32 hears its own bytes back and
            the library reads that echo to notice a collision.

    config STEF_TMC_UART_RX_GPIO
        int "UART RX GPIO"
        range 0 48
        default 41
        help
            Goes to PDN_UART directly.

    config STEF_TMC_BAUD
        int "UART baud"
        range 9600 500000
        default 115200
        help
            The TMC2209 recovers the rate from the sync byte, so this is the
            ESP32's choice rather than the driver's. 115200 is unambiguous on
            a hand-wired board; raise it once the carrier board exists.

    config STEF_TMC_UART_TRACE
        bool "Log every byte on the driver bus"
        default n
        help
            Every datagram, both directions, at info level, so it lands on the
            console and not on the link. A bad echo says the bytes did not
            match, not what did arrive, so on a silent bus this is the only
            thing that says whether anything came back at all. Costs a log
            line per datagram.

    comment "Pulse generation"

    config STEF_STEPGEN_MAX_PPS
        int "Fastest rate a driver may be asked for, in pulses per second"
        range 1000 300000
        default 100000
        help
            Not a limit of the RMT peripheral, which reaches 333k. It is what
            the board sustains with every driver running at once, since each
            one refills its channel from an interrupt. A rate above this is
            refused rather than clamped: a move that ran slower than believed
            is a position error.

            Pulses, not steps. One full step holds up to 256 of them.

    comment "Which drivers exist"

    #
    # One block per driver, each toggled on its own. A driver that is off
    # leaves no entry in the board table, so nothing above it can name it and
    # the peripherals it would have claimed stay free.
    #
    # Every driver on the wire needs a different address, and each STEP pin
    # spends one RMT channel and one PCNT unit. This part has four of each.
    #
    # A pin left at -1 is not wired, and every call that needs it is refused
    # rather than ignored.
    #

    menu "Driver 0"

        config STEF_DRV0_ENABLED
            bool "Fitted on this board"
            default y

        if STEF_DRV0_ENABLED

        config STEF_DRV0_NAME
            string "Name"
            default "capstan"
            help
                What the PC calls this driver. Name it after what it moves, so
                the name survives a rewiring.

        config STEF_DRV0_ADDR
            int "Address (MS1/MS2 straps)"
            range 0 3
            default 0
            help
                MS1 is bit 0 and MS2 is bit 1. Both pins carry internal
                pull-downs, so a driver whose straps are left open answers on 0.

        config STEF_DRV0_ENN_GPIO
            int "ENN GPIO"
            range -1 48
            default 6
            help
                Active low: high disables the power stage.

                Wants a pull-up to VIO. The pin carries no internal one, so the
                level while the ESP32 is in reset or being flashed is whatever
                the board gives it.

        config STEF_DRV0_STEP_GPIO
            int "STEP GPIO"
            range -1 48
            default 5
            help
                One pulse per microstep.

        config STEF_DRV0_DIR_GPIO
            int "DIR GPIO"
            range -1 48
            default 4

        config STEF_DRV0_DIAG_GPIO
            int "DIAG GPIO"
            range -1 48
            default -1
            help
                Input. Driver error or StallGuard, depending on GCONF.

        endif

    endmenu

    menu "Driver 1"

        config STEF_DRV1_ENABLED
            bool "Fitted on this board"
            default y

        if STEF_DRV1_ENABLED

        config STEF_DRV1_NAME
            string "Name"
            default "feed"

        config STEF_DRV1_ADDR
            int "Address (MS1/MS2 straps)"
            range 0 3
            default 1

        config STEF_DRV1_ENN_GPIO
            int "ENN GPIO"
            range -1 48
            default 17

        config STEF_DRV1_STEP_GPIO
            int "STEP GPIO"
            range -1 48
            default 16

        config STEF_DRV1_DIR_GPIO
            int "DIR GPIO"
            range -1 48
            default 15

        config STEF_DRV1_DIAG_GPIO
            int "DIAG GPIO"
            range -1 48
            default -1

        endif

    endmenu

    menu "Driver 2"

        config STEF_DRV2_ENABLED
            bool "Fitted on this board"
            default y

        if STEF_DRV2_ENABLED

        config STEF_DRV2_NAME
            string "Name"
            default "takeup"

        config STEF_DRV2_ADDR
            int "Address (MS1/MS2 straps)"
            range 0 3
            default 2

        config STEF_DRV2_ENN_GPIO
            int "ENN GPIO"
            range -1 48
            default 40

        config STEF_DRV2_STEP_GPIO
            int "STEP GPIO"
            range -1 48
            default 39

        config STEF_DRV2_DIR_GPIO
            int "DIR GPIO"
            range -1 48
            default 38

        config STEF_DRV2_DIAG_GPIO
            int "DIAG GPIO"
            range -1 48
            default -1

        endif

    endmenu

endmenu
```

## firmware/src/main/Kconfig.projbuild
```kconfig
menu "STEF Self-Test Configuration"

    config STEF_WS2812_GPIO
        int "Onboard WS2812 LED GPIO number"
        range 0 48
        default 48
        help
            GPIO driving the onboard addressable (WS2812) LED used by the
            visual-confirmation self-test. 48 on ESP32-S3-DevKitC-1 and most
            N16R8 clones. Set via "idf.py menuconfig" if your board differs.

endmenu
```
